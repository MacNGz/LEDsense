#include <Adafruit_NeoPixel.h>

Adafruit_NeoPixel leds = Adafruit_NeoPixel(2, 15, NEO_GRB + NEO_KHZ800);

int count = 0;
double times[] = {10.825, 10.85, 10.9, 10.925, 12.525, 12.75, 13.425, 13.45, 14.925, 14.95, 15.05, 15.25, 15.275,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 234.95, 237.2321};


void setup() {
  Serial.begin(9600);
  Serial.println("Hello World");

  count = 0;
  
  leds.begin(); 
  leds.show();

}

void loop() {
  // put your main code here, to run repeatedly:
 
  uint8_t r = 0;
  uint8_t g = 0;
  uint8_t b = 0;

  leds.setBrightness(15);

ry:  
  //RED to YELLOW
  r = 255;
  g = 0;
  b = 0;

  for(int i =0; i <=255;i+=5){
    leds.setPixelColor(0, r, i, b);
    leds.setPixelColor(1, r, i, b);
    delay(50);
    leds.show();

      Serial.println(millis() / 1000.0);
      Serial.println(times[count]);
      Serial.println((millis() / 1000.0) >= times[count]);
      Serial.println(sizeof(times)/sizeof(double));
  
    if (millis() / 1000.0 >= times[sizeof(times)/sizeof(double) - 1]) {
      leds.setBrightness(0);
    }
    
    if (millis() / 1000.0 >= times[count]) {
      ++count;
      goto gt;
      
    }
  }

 yg:
  //YELLOW to GREEN
  r = 255; g = 255;b =0;

  for(int i =255; i >=0;i-=5) {

    leds.setPixelColor(0, i, g, b);
    leds.setPixelColor(1, i, g, b);
    delay(50);
    leds.show();

    if (millis() / 1000.0 >= times[sizeof(times)/sizeof(double) - 1]) {
      leds.setBrightness(0);
    }
    if (millis() / 1000.0 >= times[count]) {
      ++count;
      goto tb;
    }
  }

gt:
  //GREEN to TEAL
  r =0;g =255;b =0;
  for(int i = 0; i <= 255;i+=5) {
    leds.setPixelColor(0, r, g, i);
    leds.setPixelColor(1, r, g, i);
    delay(50);
    leds.show();

    if (millis() / 1000.0 >= times[sizeof(times)/sizeof(double) - 1]) {
      leds.setBrightness(0);
    }
    if (millis() / 1000.0 >= times[count]) {
      ++count;
      goto bm;
    }
  }

tb:
  //TEAL to BLUE
  r =0;g =255;b =255;
  for(int i =255; i >=0;i-=5) {
    leds.setPixelColor(0, r, i, b);
    leds.setPixelColor(1, r, i, b);
    delay(50);
    leds.show();

    if (millis() / 1000.0 >= times[sizeof(times)/sizeof(double) - 1]) {
      leds.setBrightness(0);
    }
    if (millis() / 1000.0 >= times[count]) {
      ++count;
      goto mr;
    }
  }

bm:
  //BLUE to MAGENTA
  r =0;g =0;b =255;
  for(int i =0; i <=255;i+=5) {
    leds.setPixelColor(0, i, g, b);
    leds.setPixelColor(1, i, g, b);
    delay(50);
    leds.show();

    if (millis() / 1000.0 >= times[sizeof(times)/sizeof(double) - 1]) {
      leds.setBrightness(0);
    }
    if (millis() / 1000.0 >= times[count]) {
      ++count;
      goto ry;
    }
  }

mr:
  //MAGENTA to RED
  r =255;g =0;b =255;
  for(int i =255; i >=0;i-=5) {
    leds.setPixelColor(0, r, g, i);
    leds.setPixelColor(1, r, g, i);
    delay(50);
    leds.show();

    if (millis() / 1000.0 >= times[sizeof(times)/sizeof(double) - 1]) {
      leds.setBrightness(0);
    }
    if (millis() / 1000.0 >= times[count]) {
      ++count;
      goto yg;
    }
  }

 
  delay(100);

  leds.show();


}
